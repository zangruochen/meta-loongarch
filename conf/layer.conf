## conf/layer.conf
```bitbake
# We have a conf and classes directory, append to BBPATH
BBPATH .= ":${LAYERDIR}"

# We have a recipes directory containing .bb and .bbappend files, add to BBFILES
BBFILES += "${LAYERDIR}/recipes*/*/*.bb \
            ${LAYERDIR}/recipes*/*/*.bbappend"

BBFILE_COLLECTIONS += "loongarch"
BBFILE_PATTERN_loongarch := "^${LAYERDIR}/"
BBFILE_PRIORITY_loongarch = "9"

LAYERSERIES_COMPAT_loongarch = "kirkstone"
LAYERDEPENDS_loongarch = "core"
```

## conf/machine/include/arch-loongarch.inc
```bitbake
# LOONGARCH Architecture definition

DEFAULTTUNE ?= "loongarch"

TUNE_ARCH = "loongarch64"
TUNE_PKGARCH = "${LOONGARCHPKGSFX_VARIANT:tune-loongarch64}"

# Endianess
TUNEVALID[littleendian] = "Enable little-endian mode"
TUNE_CCARGS .= "${@bb.utils.contains('TUNE_FEATURES', 'littleendian', ' ', ' ', d)}"

# Base tunes
AVAILTUNES += "loongarch64"

TUNE_FEATURES:tune-loongarch64 = " littleendian"
BASE_LIB:tune-loongarch64 = "lib64"
LOONGARCHPKGSFX_VARIANT:tune-loongarch64 = "${TUNE_ARCH}"
PACKAGE_EXTRA_ARCHS:tune-loongarch64 = "loongarch64"
```

## conf/machine/include/loongarch/tune-loongarch64.inc
```bitbake
DEFAULTTUNE ?= "loongarch64"

require conf/machine/include/loongarch/arch-loongarch.inc
```

## conf/machine/qemuloongarch64.conf
```bitbake
PREFERRED_PROVIDER_virtual/xserver ?= "xserver-xorg"
XSERVER ?= "xserver-xorg \
            xf86-video-modesetting \
           "

MACHINE_EXTRA_RRECOMMENDS = "kernel-modules kernel-devicetree"

EXTRA_IMAGEDEPENDS += "u-boot"

include conf/machine/include/tune-loongarch64.inc

IMAGE_FSTYPES += "tar.bz2 jffs2 wic wic.bmap"
EXTRA_IMAGECMD:jffs2 = "-lnp "
IMAGE_INSTALL:append = " kernel-devicetree kernel-image-zimage"

SERIAL_CONSOLES ?= "115200;ttyS0 115200;ttyO0"
SERIAL_CONSOLES_CHECK = "${SERIAL_CONSOLES}"

PREFERRED_PROVIDER_virtual/kernel ?= "linux-loongarch"
PREFERRED_VERSION_linux-yocto ?= "5.19"

KERNEL_IMAGETYPE = "zImage"
KERNEL_DEVICETREE = "am335x-bone.dtb am335x-boneblack.dtb am335x-bonegreen.dtb"
```
